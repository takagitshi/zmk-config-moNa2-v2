## Kconfig
```kconfig
config ZMK_INPUT_PROCESSOR_GESTURE
    bool "Gesture input processor"
    default y
    depends on DT_HAS_ZMK_INPUT_PROCESSOR_GESTURE_ENABLED
    help
      Enable the layer-aware pointing gesture input processor.

config KEYBOARD_LED_POLICY
    bool "Unified timed USB/battery/Bluetooth RGB display"
    default y if SHIELD_MONA2_L || SHIELD_MONA2_R
    depends on SOC_NRF52840 && ZMK_BATTERY_REPORTING && USB_DEVICE_STACK
```

## config/west.yml
```yaml
manifest:
  remotes:
    - name: zmkfirmware
      url-base: https://github.com/zmkfirmware
    - name: sayu-hub
      url-base: https://github.com/sayu-hub
    - name: takagitshi  # <-- owned PMW3610 fork
      url-base: https://github.com/takagitshi
    # - name: sekigon-gonnoc  # <-- PAW3222
    #   url-base: https://github.com/sekigon-gonnoc
    - name: caksoylar  # <-- RGB LED
      url-base: https://github.com/caksoylar
    - name: zettaface  # <-- Input Processor Keybind
      url-base: https://github.com/zettaface
  projects:
    - name: zmk
      remote: zmkfirmware
      revision: acfd8e5ea76cf23ad1c9b6b99848f97a95224257
      import: app/west.yml
    - name: zmk-pmw3610-driver
      remote: takagitshi
      revision: f610b7795ff99d6846f81a59b94900a3b8feef78
    # - name: zmk-driver-paw3222
    #   remote: sekigon-gonnoc
    #   revision: main
    - name: zmk-rgbled-widget
      remote: caksoylar
      revision: 8756cb7b8114069fa3c25c6f6c990f24988fceff
    - name: zmk-input-processor-keybind
      remote: zettaface
      revision: 64303bd3932bfa7f49261fc6d0c9a3fdd06f8271
  self:
    path: config
```
